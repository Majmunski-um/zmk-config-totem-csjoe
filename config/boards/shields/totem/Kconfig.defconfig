## config/boards/shields/totem/Kconfig.defconfig
```kconfig
# Copyright (c) 2022 The ZMK Contributors
# SPDX-License-Identifier: MIT

config ZMK_SPLIT
    default y

config ZMK_SLEEP
    default y

config ZMK_POINTING
    default y

CONFIG_ZMK_BOARD_COMPAT=y

if SHIELD_TOTEM_DONGLE

    config ZMK_KEYBOARD_NAME
        default "TOTEM"

    config ZMK_SPLIT_ROLE_CENTRAL
        default y

    config ZMK_SPLIT_BLE_CENTRAL_PERIPHERALS
        default 2

    config ZMK_SPLIT_BLE_CENTRAL_BATTERY_LEVEL_PROXY
        default y

    config ZMK_SPLIT_BLE_CENTRAL_BATTERY_LEVEL_FETCHING
        default y

    config ZMK_STUDIO
        default y

    config BT_MAX_CONN
        default 6

    config BT_MAX_PAIRED
        default 6

endif
```
